## main/Kconfig.projbuild
```kconfig
menu "AMap Weather Configuration"

    config AMAP_API_KEY
        string "AMap Web Service API Key"
        default "47478abb752cf12e1a6c91ab0892cae0"
        help
            API Key used for the AMap IP location and live weather APIs.

endmenu
```

## sdkconfig.defaults
```kconfig
# CONFIG_MBEDTLS_HAVE_TIME_DATE is not set
CONFIG_MBEDTLS_CERTIFICATE_BUNDLE=y
CONFIG_MBEDTLS_CERTIFICATE_BUNDLE_DEFAULT_FULL=y
CONFIG_PARTITION_TABLE_SINGLE_APP_LARGE=y
CONFIG_ESPTOOLPY_FLASHSIZE_16MB=y
CONFIG_EXAMPLE_CONNECT_WIFI=y
CONFIG_EXAMPLE_WIFI_SSID="VTK"
CONFIG_EXAMPLE_WIFI_PASSWORD="AA12345678@"
# CONFIG_EXAMPLE_WIFI_AUTH_OPEN is not set
CONFIG_EXAMPLE_WIFI_AUTH_WPA2_PSK=y
```
